// Configuration for Corne v3/v3.6 with native 5-pin nice_view display support
// This board has the display header built-in, no adapter needed
// FINAL: SCK=P0.20, MOSI=P0.18, CS=P0.06 (standard nice_view pinout)

nice_view_spi: &spi3 {
    cs-gpios = <&pro_micro 16 GPIO_ACTIVE_HIGH>;
};



// Disable OLED and I2C when using nice_view
&pro_micro_i2c {
    status = "disabled";
};

&oled {
    status = "disabled";
};

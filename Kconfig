## Kconfig
```kconfig
rsource "drivers/input/Kconfig"

config CORNE_BATTERY_HID
    bool "Expose the split peripherals' battery levels over USB HID (dongle)"
    depends on ZMK_USB && ZMK_SPLIT_BLE_CENTRAL_BATTERY_LEVEL_FETCHING
    help
      Adds a vendor-defined USB HID interface (needs USB_HID_DEVICE_COUNT=2) whose feature
      report holds each peripheral's battery level. Read by tools/corne-battery.
```

## drivers/input/Kconfig
```kconfig
menuconfig INPUT_AZOTEQ_IQS5XX
    bool "Azoteq IQS5xx trackpads"
    default y
    depends on GPIO
    depends on I2C
    depends on INPUT
    depends on DT_HAS_AZOTEQ_IQS5XX_ENABLED
    help
      Enable driver for Azoteq IQS5xx trackpads.

if INPUT_AZOTEQ_IQS5XX

config INPUT_AZOTEQ_IQS5XX_INIT_PRIORITY
    int "Azoteq IQS5xx initialization priority"
    default INPUT_INIT_PRIORITY
    help
      Driver initialization priority for the IQS5xx driver.
      Lower values initialize earlier.

config INPUT_AZOTEQ_IQS5XX_POLL_INTERVAL_MS
    int "Poll interval while ZMK is active, when rdy-gpios is not wired"
    default 10
    help
      ~ the trackpad's report period while touched. Lower is smoother, higher saves power.

config INPUT_AZOTEQ_IQS5XX_IDLE_POLL_INTERVAL_MS
    int "Poll interval while ZMK is idle, when rdy-gpios is not wired"
    default 200
    help
      Worst-case delay before a touch is noticed after ZMK_IDLE_TIMEOUT. Set it equal to
      INPUT_AZOTEQ_IQS5XX_POLL_INTERVAL_MS to never slow down.

endif # INPUT_AZOTEQ_IQS5XX
```
